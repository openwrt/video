## frameworks/qt5/qt5base/Config.in
```kconfig
config BUILD_qt5base-core_INOTIFY
    bool "Use native inotify support on Linux"
    depends on PACKAGE_qt5base-core
    default y
    help
        "Compiles qt5's QFileSystemWatcher with support for inotify on Linux. Otherwise QFileSystemWatcher uses polling as fallback."

config BUILD_qt5base-network_SSL
    bool "Include native SSL support"
    depends on PACKAGE_qt5base-network
    default y

config BUILD_qt5base-gui_DRM
    bool "Include DRM support"
    depends on PACKAGE_qt5base-gui
    default y

choice
    prompt "Which OpenGL variant to use"
    default BUILD_qt5base-gui_OPENGL_NONE
    depends on PACKAGE_qt5base-gui

config BUILD_qt5base-gui_OPENGL_OPENGLES2
    bool "es2"

config BUILD_qt5base-gui_OPENGL_NONE
    bool "no"

endchoice
```
